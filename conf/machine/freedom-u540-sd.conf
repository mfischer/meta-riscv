## conf/machine/freedom-u540-sd.conf
```bitbake
#@TYPE: Machine
#@NAME: freedom-u540-sd
#@SOC: Freedom U540
#@DESCRIPTION: Machine configuration for the HiFive Unleashed development board booting from SD card

include freedom-u540-common.inc

RISCV_BBL_PAYLOAD = "${KERNEL_IMAGETYPE}-${MACHINE}.bin"
```
